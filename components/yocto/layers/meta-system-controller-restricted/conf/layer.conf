## components/yocto/layers/meta-system-controller-restricted/conf/layer.conf
```bitbake
# We have a conf and classes directory, add to BBPATH
BBPATH .= ":${LAYERDIR}"

# We have recipes-* directories, add to BBFILES
BBFILES += "${LAYERDIR}/recipes-*/*/*.bb \
            ${LAYERDIR}/recipes-*/*/*.bbappend"

BBFILE_COLLECTIONS += "system-controller-internal"
BBFILE_PATTERN_system-controller-internal = "^${LAYERDIR}/"
BBFILE_PRIORITY_system-controller-internal = "6"
BBFILE_PATTERN_IGNORE_EMPTY_system-controller-internal = "1"

LAYERDEPENDS_system-controller-internal = "core xilinx meta-system-controller"

LAYERSERIES_COMPAT_system-controller-internal = "scarthgap"
```
